## conf/layer.conf
```bitbake
# We have a conf and classes directory, add to BBPATH
BBPATH .= ":${LAYERDIR}"

# We have recipes-* directories, add to BBFILES
BBFILES += "${LAYERDIR}/recipes-*/*/*.bb \
	${LAYERDIR}/recipes-*/*/*.bbappend"

BBFILE_COLLECTIONS += "hwh"
BBFILE_PATTERN_hwh = "^${LAYERDIR}/"
BBFILE_PRIORITY_hwh = "6"

#PREFERRED_VERSION_libdrm ?= "git"
#PREFERRED_VERSION_mesa ?= "git"
#PREFERRED_PROVIDER ?= "ffmpeg"
PREFERRED_PROVIDER_virtual/libiconv ?= "libiconv"
#PREFERRED_PROVIDER_virtual/libgles2 ?= "mesa"
#PREFERRED_PROVIDER_jpeg-native ?= "jpeg-native"
```
